## Master/main/Kconfig.projbuild
```kconfig
menu "WIFI_DATABASE Configuration"

    config ESP_WIFI_SSID
        string "WiFi SSID for Access Point"
        default "YuhaoMaTest"
        help
            SSID (network name) for the AP.

    config ESP_WIFI_PASSWORD
        string "WiFi Password for Access Point"
        default "mayuhaodashuaige"
        help
            WiFi password (WPA or WPA2) for the AP.

    config ESP_WIFI_CHANNEL
        int "WiFi Channel"
        range 1 13
        default 1
        help
            WiFi channel (network channel) for the AP.

    config ESP_MAX_STA_CONN
        int "Maximal STA connections"
        default 4
        help
            Max number of the STA connects to AP.

    config SERVER_PORT
        int "TCP socket port"
        range 0 65535
        default 3333
        help
            Local port the TCP server will listen on.
endmenu

menu "Example Configuration"

    config ESP_WIFI_SSID
        string "WiFi SSID"
        default "myssid"
        help
            SSID (network name) for the example to connect to.

    config ESP_WIFI_PASSWORD
        string "WiFi Password"
        default "mypassword"
        help
            WiFi password (WPA or WPA2) for the example to use.

    config ESP_MAXIMUM_RETRY
        int "Maximum retry"
        default 5
        help
            Set the Maximum retry to avoid station reconnecting to the AP unlimited when the AP is really inexistent.

    choice ESP_WIFI_SCAN_AUTH_MODE_THRESHOLD
        prompt "WiFi Scan auth mode threshold"
        default ESP_WIFI_AUTH_WPA2_PSK
        help
            The weakest authmode to accept in the scan mode.
            This value defaults to ESP_WIFI_AUTH_WPA2_PSK incase password is present and ESP_WIFI_AUTH_OPEN is used.
            Please select ESP_WIFI_AUTH_WEP/ESP_WIFI_AUTH_WPA_PSK incase AP is operating in WEP/WPA mode.

        config ESP_WIFI_AUTH_OPEN
            bool "OPEN"
        config ESP_WIFI_AUTH_WEP
            bool "WEP"
        config ESP_WIFI_AUTH_WPA_PSK
            bool "WPA PSK"
        config ESP_WIFI_AUTH_WPA2_PSK
            bool "WPA2 PSK"
        config ESP_WIFI_AUTH_WPA_WPA2_PSK
            bool "WPA/WPA2 PSK"
        config ESP_WIFI_AUTH_WPA3_PSK
            bool "WPA3 PSK"
        config ESP_WIFI_AUTH_WPA2_WPA3_PSK
            bool "WPA2/WPA3 PSK"
        config ESP_WIFI_AUTH_WAPI_PSK
            bool "WAPI PSK"
    endchoice

endmenu
menu "Application Configuration"
	config PAYLOAD_SIZE
		int "Payload size (byte)"
		range 1 32
		default 32
		help
			Payload size.

	config RECEIVER_ADDRESS
		depends on RECEIVER
		string "My address"
		default "FGHIJ"
		help
			My address.

	config DESTINATION_ADDRESS
		depends on TRANSMITTER
		string "Destination address"
		default "FGHIJ"
		help
			Destination address.

	config RADIO_CHANNEL
		int "Radio channel to use"
		range 1 127
		default 6
		help
			Radio channel to use.

endmenu

menu "nRF24L01 Configuration"

	config GPIO_RANGE_MAX
		int
		default 33 if IDF_TARGET_ESP32
		default 46 if IDF_TARGET_ESP32S2
		default 48 if IDF_TARGET_ESP32S3
		default 18 if IDF_TARGET_ESP32C2
		default 19 if IDF_TARGET_ESP32C3

	config MISO_GPIO
		int "MISO GPIO number"
		range 0 GPIO_RANGE_MAX
		default 19 if IDF_TARGET_ESP32
		default 37 if IDF_TARGET_ESP32S2 || IDF_TARGET_ESP32S3
		default  4 if IDF_TARGET_ESP32C3 || IDF_TARGET_ESP32C2
		help
			GPIO number (IOxx) to SPI MISO.
			Some GPIOs are used for other purposes (flash connections, etc.) and cannot be used to MISO.
			On the ESP32, GPIOs 35-39 are input-only so cannot be used as outputs.
			On the ESP32-S2, GPIO 46 is input-only so cannot be used as outputs.

	config MOSI_GPIO
		int "MOSI GPIO number"
		range 0 GPIO_RANGE_MAX
		default 23 if IDF_TARGET_ESP32
		default 35 if IDF_TARGET_ESP32S2 || IDF_TARGET_ESP32S3
		default  3 if IDF_TARGET_ESP32C3 || IDF_TARGET_ESP32C2
		help
			GPIO number (IOxx) to SPI MOSI.
			Some GPIOs are used for other purposes (flash connections, etc.) and cannot be used to MOSI.
			On the ESP32, GPIOs 35-39 are input-only so cannot be used as outputs.
			On the ESP32-S2, GPIO 46 is input-only so cannot be used as outputs.

	config SCLK_GPIO
		int "SCLK GPIO number"
		range 0 GPIO_RANGE_MAX
		default 18 if IDF_TARGET_ESP32
		default 36 if IDF_TARGET_ESP32S2 || IDF_TARGET_ESP32S3
		default  2 if IDF_TARGET_ESP32C3 || IDF_TARGET_ESP32C2
		help
			GPIO number (IOxx) to SPI SCLK.
			Some GPIOs are used for other purposes (flash connections, etc.) and cannot be used to SCLK.
			On the ESP32, GPIOs 35-39 are input-only so cannot be used as outputs.
			On the ESP32-S2, GPIO 46 is input-only so cannot be used as outputs.

	config CE_GPIO
		int "CE GPIO number"
		range 0 GPIO_RANGE_MAX
		default 16 if IDF_TARGET_ESP32
		default 48 if IDF_TARGET_ESP32S2 || IDF_TARGET_ESP32S3
		default  1 if IDF_TARGET_ESP32C3 || IDF_TARGET_ESP32C2
		help
			GPIO number (IOxx) to CE.
			Some GPIOs are used for other purposes (flash connections, etc.) and cannot be used to CE.
			On the ESP32, GPIOs 35-39 are input-only so cannot be used as outputs.
			On the ESP32-S2, GPIO 46 is input-only so cannot be used as outputs.

	config CSN_GPIO
		int "CSN GPIO number"
		range 0 GPIO_RANGE_MAX
		default 17 if IDF_TARGET_ESP32
		default 38 if IDF_TARGET_ESP32S2 || IDF_TARGET_ESP32S3
		default  0 if IDF_TARGET_ESP32C3 || IDF_TARGET_ESP32C2
		help
			GPIO number (IOxx) to CSN.
			Some GPIOs are used for other purposes (flash connections, etc.) and cannot be used to CSN.
			On the ESP32, GPIOs 35-39 are input-only so cannot be used as outputs.
			On the ESP32-S2, GPIO 46 is input-only so cannot be used as outputs.

	choice SPI_HOST
		prompt "SPI peripheral that controls this bus"
		default SPI2_HOST
		help
			Select SPI peripheral that controls this bus.
		config SPI2_HOST
			bool "SPI2_HOST"
			help
				Use SPI2_HOST. This is also called HSPI_HOST.
		config SPI3_HOST
			depends on IDF_TARGET_ESP32 || IDF_TARGET_ESP32S2 || IDF_TARGET_ESP32S3
			bool "SPI3_HOST"
			help
				USE SPI3_HOST. This is also called VSPI_HOST
	endchoice

endmenu 
```
